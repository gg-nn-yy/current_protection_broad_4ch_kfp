/* ======================== 头文件 ========================================== */
#include <stdlib.h>
#include "stm32f0xx.h"
#include "systick.h"



/* ======================== 全局变量定义区 ================================== */
static volatile uint64_t g_sysRunTime = 0;
static void (*g_pTaskScheduleFunc)(void) = NULL;



/* ======================== 宏函数定义区 ==================================== */



/* ======================== 局部接口定义区 ================================== */



/* ======================== 对外接口定义区 ================================== */
/*******************************************************************************
 * @brief  注册任务调度回调函数
 *
 * @param  pFunc:传入回调函数地址
 *
 * @return 
* * * * * * * * * * * * * * * * * * * * * * * * * * * * * * * * * * * * * * * */
void vTaskScheduleCbReg(void (*pFunc)(void))
{
	g_pTaskScheduleFunc = pFunc;
}


/******************************************************************************
 * @brief systick初始化
 *
 * @param 
 *
 * @return 
* * * * * * * * * * * * * * * * * * * * * * * * * * * * * * * * * * * * * * * */
void vSystickInit(void)
{
	/* 1ms产生一次中断 */
	if (SysTick_Config(SystemCoreClock / 6000)) {
		while(1);
	}
}


/*******************************************************************************
 * @brief 定时中断服务函数，1ms产生一次中断
 *
 * @param
 *
 * @return 
* * * * * * * * * * * * * * * * * * * * * * * * * * * * * * * * * * * * * * * */
void SysTick_Handler(void)
{
	g_sysRunTime++;
	if (NULL == g_pTaskScheduleFunc) {
		return;
	}
	g_pTaskScheduleFunc();
}


/*******************************************************************************
 * @brief	获取系统运行时间
 *
 * @param 
 *
 * @return 	以1ms为单位
* * * * * * * * * * * * * * * * * * * * * * * * * * * * * * * * * * * * * * * */
uint64_t ulSysRunTimeGet(void)
{
	return g_sysRunTime;
}
